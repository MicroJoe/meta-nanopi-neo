## conf/machine/nanopi-neo.conf
```bitbake
#@TYPE: Machine
#@NAME: nanopi-neo
#@DESCRIPTION: Machine configuration for nanopi-neo

require conf/machine/include/sun8i.inc

PREFERRED_PROVIDER_virtual/kernel = "linux-megous"
PREFERRED_VERSION_linux = "4.14"

PREFERRED_PROVIDER_virtual/bootloader = "u-boot"
PREFERRED_VERSION_u-boot = "v2016.11%"

KERNEL_DEVICETREE = "sun8i-h3-nanopi-neo.dtb"
UBOOT_MACHINE = "nanopi_neo_defconfig"

MACHINE_EXTRA_RRECOMMENDS += " kernel-modules linux-firmware-brcm43438"
MACHINE_EXTRA_FEATURES += "ext2 serial usbgadget usbhost vfat"
# KERNEL_MODULE_AUTOLOAD += " g_serial"
```
